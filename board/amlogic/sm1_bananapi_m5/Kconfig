## board/amlogic/sm1_bananapi_m5/Kconfig
```kconfig
if TARGET_SM1_BANANAPI_M5

config SYS_SOC
	default "g12a"

config SYS_BOARD
	default "sm1_bananapi_m5"

config SYS_VENDOR
	default "amlogic"

config SYS_CONFIG_NAME
	default "sm1_bananapi_m5"

config AML_REBOOT
       bool "reboot cmd"
       default y
       help
         support uboot reboot cmd

endif
```
